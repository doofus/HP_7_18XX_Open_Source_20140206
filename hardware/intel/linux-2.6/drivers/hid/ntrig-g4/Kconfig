## hardware/intel/linux-2.6/drivers/hid/ntrig-g4/Kconfig
```kconfig
config HID_NTRIG_G4
	tristate "N-Trig g4 touch screen"
	depends on USB_HID
	---help---
	Support for N-Trig g4 touch screen.

config NTRIG_SPI_G4
	tristate "NTrig"
	---help---
	Support for N-Trig g4 touch screen spi
```

## hardware/intel/linux-2.6/drivers/tdlock/Kconfig
```kconfig
#
# TD lock driver configuration
#

config TDLOCK
    depends on TCG_TPM
	tristate "Theft Deterrent lock driver"
```
